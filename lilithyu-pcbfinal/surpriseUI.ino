int myCounter = -1;
bool rst = true;

void displaySurprise(long randNumber, sensors_event_t a, sensors_event_t g) {
  display.clearDisplay();
  display.setTextColor(WHITE);
  display.setTextSize(1);
  display.setCursor(0, 0);

  if (randNumber == 0) {
    knockKnock(a, g);
  } else if (randNumber == 1) {
    dogPic();
  }

  display.display();
}

void knockKnock(sensors_event_t a, sensors_event_t g) {
/* constants */
   if (surpriseRst) {
   myCounter = -1;
   surpriseRst = false;
  }
  
//  display.fillRect(10, 10, 10, 10);
  display.setTextColor(WHITE, BLACK);
  display.setCursor(0, 55);
  display.print(">");
  display.setCursor(0, 0);
  display.println("Knock knock.");
  
  if (myCounter == 0) {
    display.setCursor(56, 55);
    display.print("Who's there?");
  }
  
  if (a.acceleration.x < -3 && rst) {
    myCounter++;
    rst = false;
  }
  
  else if (a.acceleration.x >= 0) {
    rst = true;
  }
  
  if (a.acceleration.x > 2.9) {
    myCounter = -1;
  }
  
 SerialUSB.print("Count: ");
 SerialUSB.println(myCounter);
  if (myCounter >= 1) {
    display.setTextColor(WHITE, BLACK);
    if (myCounter == 1) {
      display.setCursor(80, 55);
      display.print("PCB who?");
    }
    display.setCursor(56, 10);
    display.print("Who's there?");
    display.setCursor(0, 20);
    display.print("PCB.");
  }

  if (myCounter >= 2) {
    display.setCursor(80, 30);
    display.print("PCB who?");
    display.setCursor(0, 40);
    display.print("I'm sorry, I can't h-ear you over the sound of these traces!");
  }

  display.display();
}

void dogPic() {
// 'vector-baby-elephant-heart-illustration-260nw-1926542561', 128x64px
  const unsigned char myBitmap [] PROGMEM = {
    0x00, 0x00, 0x00, 0x00, 0x00, 0x00, 0x00, 0x00, 0x00, 0x00, 0x00, 0x00, 0x00, 0x00, 0x00, 0x00, 
    0x00, 0x00, 0x00, 0x00, 0x00, 0x00, 0x00, 0x00, 0x00, 0x00, 0x00, 0x00, 0x00, 0x00, 0x00, 0x00, 
    0x00, 0x00, 0x00, 0x00, 0x07, 0xe0, 0x00, 0x00, 0x00, 0x00, 0x00, 0x00, 0x00, 0x00, 0x00, 0x00, 
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    0x00, 0x00, 0x00, 0x00, 0x00, 0x00, 0x00, 0x00, 0x00, 0x00, 0x00, 0x00, 0x00, 0x00, 0x00, 0x00
  };


  display.drawBitmap(0, 0, myBitmap, 128, 64, WHITE);
  display.setCursor(70, 0);
  display.print("elephant!");

}
