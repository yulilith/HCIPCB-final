void displaySurprise(long randNumber, sensors_event_t a, bool k1, bool k2, bool k3) {
  display.clearDisplay();
  display.setTextColor(WHITE);
  display.setTextSize(1);
  display.setCursor(0, 0);

  if (randNumber == 0) {
    knockKnock(k1, k2, k3, a);
  } else if (randNumber == 1) {
    dogPic();
  } else if (randNumber == 2) {
    dogPic();
  }

  display.display();
}

void knockKnock(bool k1, bool k2, bool k3, sensors_event_t a) {
/* constants */
  
//  display.fillRect(10, 10, 10, 10);
  display.setTextColor(WHITE, BLACK);
  display.setCursor(0, 55);
  display.print(">");
  display.setCursor(0, 0);
  display.println("Knock knock.");
  k1 = true;
  delay(1000);
  if (k1) {
    display.setCursor(55, 55);
    display.print("Who's there?");
  }
  if (a.acceleration.y < -2) {
    k2 = true;
  }
  if (k2) {
    display.setTextColor(WHITE, BLACK);
    display.print("PCB who?");
    display.setCursor(55, 10);
    display.print("Who's there?");
    display.setCursor(0, 20);
    display.print("PCB.");
  }

  display.display();
}

void dogPic() {
// 'vector-baby-elephant-heart-illustration-260nw-1926542561', 128x64px
  const unsigned char myBitmap [] PROGMEM = {
    0x00, 0x00, 0x00, 0x00, 0x00, 0x00, 0x00, 0x00, 0x00, 0x00, 0x00, 0x00, 0x00, 0x00, 0x00, 0x00, 
    0x00, 0x00, 0x00, 0x00, 0x00, 0x00, 0x00, 0x00, 0x00, 0x00, 0x00, 0x00, 0x00, 0x00, 0x00, 0x00, 
    0x00, 0x00, 0x00, 0x00, 0x07, 0xe0, 0x00, 0x00, 0x00, 0x00, 0x00, 0x00, 0x00, 0x00, 0x00, 0x00, 
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    0x00, 0x00, 0x00, 0x00, 0x00, 0x00, 0x00, 0x00, 0x00, 0x00, 0x00, 0x00, 0x00, 0x00, 0x00, 0x00
  };


  display.drawBitmap(0, 0, myBitmap, 128, 64, WHITE);
  display.setCursor(45, 0);
  display.print("cute elephant!");

}
